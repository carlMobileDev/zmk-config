## config/west.yml
```yaml
manifest:
  remotes:
    - name: zmkfirmware
      url-base: https://github.com/zmkfirmware
    - name: urob
      url-base: https://github.com/urob

  projects:
    - name: zmk
      remote: zmkfirmware
      revision: v0.3
      import: app/west.yml

    # Urob's zmk helpers for key position defines
    - name: zmk-helpers
      remote: urob
      revision: v2

  self:
    path: config
```
